## meta-facebook/meta-tiogapass/conf/machine/tiogapass.conf
```bitbake
KMACHINE = "aspeed"
KERNEL_DEVICETREE = "${KMACHINE}-bmc-facebook-${MACHINE}-pruned.dtb"

PREFERRED_PROVIDER_virtual/bootloader = "u-boot-aspeed-sdk"
PREFERRED_PROVIDER_u-boot = "u-boot-aspeed-sdk"
PREFERRED_PROVIDER_u-boot-fw-utils = "u-boot-fw-utils-aspeed-sdk"

UBOOT_DEVICETREE = "ast2500-evb"
UBOOT_MACHINE = "evb-ast2500_defconfig"

OBMC_COMPATIBLE_NAMES = "com.meta.Hardware.BMC.Model.TiogaPass"

#require conf/machine/include/facebook-compute-singlehost.inc
require conf/machine/include/ast2500.inc
require conf/machine/include/obmc-bsp-common.inc

FLASH_SIZE = "32768"

IMAGE_FEATURES:append = " allow-root-login"

# Most of our hardware uses the default ttyS4 but at 57600.
SERIAL_CONSOLES = "57600;ttyS4"

IMAGE_FEATURES:remove = "obmc-fan-control"
IMAGE_FEATURES:remove = "obmc-fan-mgmt"
IMAGE_FEATURES:remove = "obmc-flash-mgmt"
```

## meta-ibm/meta-genesis3/conf/machine/genesis3.conf
```bitbake
KMACHINE = "aspeed"
KERNEL_DEVICETREE = "${KMACHINE}-bmc-ibm-${MACHINE}.dtb"

UBOOT_MACHINE = "evb-ast2500_defconfig"
UBOOT_MAKE_TARGET += " DEVICE_TREE=ast2500-genesis3"

OBMC_POWER_SUPPLY_INSTANCES = "0 1"

MACHINE_FEATURES += " \
        obmc-bmc-state-mgmt \
        obmc-phosphor-fan-mgmt \
        obmc-phosphor-chassis-mgmt \
        obmc-chassis-state-mgmt \
        obmc-host-state-mgmt \
        "

require conf/machine/include/ast2500.inc
require conf/machine/include/obmc-bsp-common.inc

PREFERRED_PROVIDER_virtual/phosphor-led-manager-config-native = "gen3-led-manager-config-native"
```

## meta-ocp/conf/machine/include/ocp.inc
```bitbake
VIRTUAL-RUNTIME_obmc-host-state-manager = "x86-power-control"
VIRTUAL-RUNTIME_obmc-chassis-state-manager = "x86-power-control"
VIRTUAL-RUNTIME_obmc-sensors-hwmon = "dbus-sensors"
VIRTUAL-RUNTIME_obmc-inventory-manager = "entity-manager"

PREFERRED_PROVIDER_virtual/obmc-chassis-mgmt = "packagegroup-ocp-apps"
PREFERRED_PROVIDER_virtual/obmc-fan-mgmt = "packagegroup-ocp-apps"
PREFERRED_PROVIDER_virtual/obmc-flash-mgmt = "packagegroup-ocp-apps"
PREFERRED_PROVIDER_virtual/obmc-system-mgmt = "packagegroup-ocp-apps"
```

## meta-ocp/meta-yv3/conf/layer.conf
```bitbake
# We have a conf and classes directory, add to BBPATH
BBPATH .= ":${LAYERDIR}"

# We have recipes-* directories, add to BBFILES
BBFILES += "${LAYERDIR}/recipes-*/*/*.bb \
            ${LAYERDIR}/recipes-*/*/*.bbappend"

BBFILE_COLLECTIONS += "yv3-layer"
BBFILE_PATTERN_yv3-layer = "^${LAYERDIR}/"
BBFILE_PRIORITY_yv3-layer = "5"
LAYERSERIES_COMPAT_yv3-layer = "nanbield scarthgap"
```

## meta-wiwynn/conf/layer.conf
```bitbake
# We have a conf and classes directory, add to BBPATH
BBPATH .= ":${LAYERDIR}"

# We have recipes-* directories, add to BBFILES
BBFILES += "${LAYERDIR}/recipes-*/*/*.bb \
            ${LAYERDIR}/recipes-*/*/*.bbappend"

BBFILE_COLLECTIONS += "wiwynn-layer"
BBFILE_PATTERN_wiwynn-layer := "^${LAYERDIR}/"
LAYERSERIES_COMPAT_wiwynn-layer := "langdale mickledore"
```

## meta-wiwynn/meta-tiogapass-w/conf/layer.conf
```bitbake
# We have a conf and classes directory, add to BBPATH
BBPATH .= ":${LAYERDIR}"

# We have recipes-* directories, add to BBFILES
BBFILES += "${LAYERDIR}/recipes-*/*/*.bb \
            ${LAYERDIR}/recipes-*/*/*.bbappend"

BBFILE_COLLECTIONS += "tiogapass-w-layer"
BBFILE_PATTERN_tiogapass-w-layer := "^${LAYERDIR}/"

LAYERSERIES_COMPAT_tiogapass-w-layer := "langdale mickledore"
```
