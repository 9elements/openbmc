## meta-asrock/meta-turin2d24tm3-2l/conf/machine/turin2d24tm3-2l.conf
```bitbake
KMACHINE = "aspeed"
KERNEL_DEVICETREE = "aspeed/${KMACHINE}-bmc-asrock-${MACHINE}.dtb"

UBOOT_MACHINE = "ast2600_openbmc_spl_defconfig"
#UBOOT_DEVICETREE = "asrock-turin2d24tm3-2l-u-boot"
UBOOT_DEVICETREE = "ast2600-evb"
SOCSEC_SIGN_ENABLE = "0"
SPL_BINARY = "spl/u-boot-spl.bin"

FLASH_SIZE = "65536"

require conf/machine/include/ast2600.inc
require conf/machine/include/obmc-bsp-common.inc
require conf/machine/include/asrock.inc

VIRTUAL-RUNTIME_obmc-host-state-manager ?= "x86-power-control"
VIRTUAL-RUNTIME_obmc-chassis-state-manager ?= "x86-power-control"

PREFERRED_PROVIDER_virtual/obmc-chassis-mgmt = "packagegroup-asrock-apps"
PREFERRED_PROVIDER_virtual/obmc-host-ipmi-hw ?= "phosphor-ipmi-kcs"
```

## meta-ocp/meta-yv3/conf/machine/yv3.conf
```bitbake
KMACHINE = "aspeed"
KERNEL_DEVICETREE = "aspeed/${KMACHINE}-bmc-ocp-${MACHINE}.dtb"

UBOOT_MACHINE = "evb-ast2500_defconfig"
UBOOT_DEVICETREE = "ast2500-evb"

# technically our flash is 128 MB but we pretend it is 64 MB
# due to our EM100 mysteriously shifting all reads by 64 MB
#FLASH_SIZE = "131072"
FLASH_SIZE = "65536"

require conf/machine/include/ast2500.inc
require conf/machine/include/obmc-bsp-common.inc


MACHINE_FEATURES += "\
        obmc-phosphor-chassis-mgmt \
        obmc-phosphor-flash-mgmt \
        obmc-phosphor-fan-mgmt \
        obmc-chassis-state-mgmt \
        obmc-host-state-mgmt \
        obmc-bmc-state-mgmt \
        obmc-host-ipmi \
        ncsi \
        "

VIRTUAL-RUNTIME_obmc-inventory-manager = "entity-manager"
PREFERRED_PROVIDER_virtual/obmc-inventory-data = "entity-manager"

PREFERRED_PROVIDER_virtual/obmc-chassis-mgmt = "packagegroup-ocp-apps"
PREFERRED_PROVIDER_virtual/obmc-flash-mgmt = "packagegroup-ocp-apps"
PREFERRED_PROVIDER_virtual/obmc-host-ipmi-hw ?= "phosphor-ipmi-kcs"
PREFERRED_PROVIDER_virtual/obmc-system-mgmt = "packagegroup-ocp-apps"

OBMC_HOST_INSTANCES = "1 2 3 4"
```

## meta-u-bmc/conf/distro/u-bmc.conf
```bitbake
require conf/distro/openbmc-phosphor.conf
require conf/distro/include/phosphor-no-webui.inc

U-BMC_VERSION ?= "0.1.0"
DISTRO = "u-bmc"
DISTRO_NAME = "u-bmc"
DISTRO_VERSION = "u-bmc-release-${U-BMC_VERSION}"
EXTENDED_VERSION = "${DISTRO_VERSION}"
DISTROOVERRIDES .= ":u-bmc"

# Possible values: "dev", "prod", "local"
U-BMC_CONFIG ?= "local"
OVERRIDES .= ":${U-BMC_CONFIG}:"
# local config will also include dev config
OVERRIDES:append:local = ":dev:"

DISTRO_FEATURES:remove = "obmc-host-ctl"
DISTRO_FEATURES:remove = "obmc-host-ipmi"
DISTRO_FEATURES:remove = "obmc-phosphor-chassis-mgmt"
DISTRO_FEATURES:remove = "obmc-phosphor-fan-mgmt"
DISTRO_FEATURES:remove = "obmc-phosphor-flash-mgmt"
DISTRO_FEATURES:remove = "obmc-phosphor-system-mgmt"

WATCHDOG_PKG ?= "watchdog"

# Provides reasonable data integrity and faster than sha*
FIT_HASH_ALG = "crc32"
```

## meta-u-bmc/conf/layer.conf
```bitbake
BBPATH .= ":${LAYERDIR}"
BBFILES += "${LAYERDIR}/recipes-*/*/*.bb \
            ${LAYERDIR}/recipes-*/*/*.bbappend"
BBFILE_COLLECTIONS += "u-bmc-layer"
BBFILE_PATTERN_u-bmc-layer = "^${LAYERDIR}/"
LAYERVERSION_COMPAT_u-bmc-layer = "1"
LAYERSERIES_COMPAT_u-bmc-layer = "whinlatter walnascar"
LAYERDEPENDS_u-bmc-layer += "core phosphor-layer"
```

## meta-u-bmc/meta-turin2d24tm3-2l/conf/machine/turin2d24tm3-2l.conf
```bitbake
KMACHINE = "aspeed"
KERNEL_DEVICETREE = "aspeed/${KMACHINE}-bmc-asrock-${MACHINE}.dtb"

UBOOT_MACHINE = "ast2600_openbmc_spl_defconfig"
#UBOOT_DEVICETREE = "asrock-turin2d24tm3-2l-u-boot"
UBOOT_DEVICETREE = "ast2600-evb"
SOCSEC_SIGN_ENABLE = "0"
SPL_BINARY = "spl/u-boot-spl.bin"

FLASH_SIZE = "65536"

require conf/machine/include/ast2600.inc
include conf/machine/include/obmc-bsp-common.inc

MACHINE_FEATURES:remove = "obmc-host-ipmi"

IMAGE_FEATURES:remove = " \
    obmc-bmc-state-mgmt \
    obmc-bmcweb \
    obmc-chassis-mgmt \
    obmc-chassis-state-mgmt \
    obmc-console \
    obmc-dbus-monitor \
    obmc-debug-collector \
    obmc-devtools \
    obmc-fan-control \
    obmc-fan-mgmt \
    obmc-flash-mgmt \
    obmc-health-monitor \
    obmc-host-ctl \
    obmc-host-ipmi \
    obmc-host-state-mgmt \
    obmc-ikvm \
    obmc-inventory \
    obmc-leds \
    obmc-logging-mgmt \
    obmc-remote-logging-mgmt \
    obmc-sensors \
    obmc-settings-mgmt \
    obmc-software \
    obmc-system-mgmt \
    obmc-telemetry \
    obmc-webui \
"
```

## meta-workshop/meta-workshopplatform/conf/machine/workshopplatform.conf
```bitbake
KERNEL_DEVICETREE = "aspeed/aspeed-ast2600-evb.dtb"

UBOOT_MACHINE = "ast2600_openbmc_spl_defconfig"
UBOOT_DEVICETREE = "ast2600-evb"
SPL_BINARY = "spl/u-boot-spl.bin"
# Disable hardware root of trust by default.
# If users want to enable secure boot,
# please do the following steps.
# 1. Set SOCSEC_SIGN_ENABLE to “1”.
# 2. Provide platform OTP config.
# There was an example in p10bmc.
# If users enable socsec signing but do not provide OTP config,
# u-boot will be built failed.
SOCSEC_SIGN_ENABLE = "0"

require conf/machine/include/ast2600.inc
# include conf/machine/include/obmc-evb-common.inc

SERIAL_CONSOLES = "115200;ttyS4"

# AST2600 EVB has 64MB SPI flash
FLASH_SIZE = "65536"

include conf/distro/include/mctp.inc

VIRTUAL-RUNTIME_obmc-inventory-manager = "entity-manager"
PREFERRED_PROVIDER_virtual/obmc-inventory-data = "entity-manager"

MACHINE_FEATURES += "\
   obmc-bmc-state-mgmt \
   obmc-chassis-state-mgmt \
   obmc-host-ipmi \
   obmc-host-state-mgmt \
   obmc-phosphor-chassis-mgmt \
   obmc-phosphor-fan-mgmt \
   obmc-phosphor-flash-mgmt \
   "

VIRTUAL-RUNTIME_obmc-inventory-manager = "entity-manager"
PREFERRED_PROVIDER_virtual/obmc-inventory-data = "entity-manager"

VIRTUAL-RUNTIME_obmc-host-state-manager ?= "x86-power-control"
VIRTUAL-RUNTIME_obmc-chassis-state-manager ?= "x86-power-control"

PREFERRED_PROVIDER_virtual/obmc-chassis-mgmt = "packagegroup-workshop-extras"
PREFERRED_PROVIDER_virtual/obmc-fan-mgmt = "packagegroup-workshop-extras"
PREFERRED_PROVIDER_virtual/obmc-flash-mgmt = "packagegroup-workshop-extras"
PREFERRED_PROVIDER_virtual/obmc-host-ipmi-hw ?= "phosphor-ipmi-kcs"
PREFERRED_PROVIDER_virtual/obmc-system-mgmt = "packagegroup-workshop-extras"

IMAGE_INSTALL:append = " packagegroup-workshop-extras "
```
